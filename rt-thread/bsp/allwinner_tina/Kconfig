## rt-thread/bsp/allwinner_tina/Kconfig
```kconfig
mainmenu "RT-Thread Configuration"

config BSP_DIR
    string
    option env="BSP_ROOT"
    default "."

config RTT_DIR
    string
    option env="RTT_ROOT"
    default "../.."

# you can change the RTT_ROOT default "rt-thread"
# example : default "F:/git_repositories/rt-thread"

config PKGS_DIR
    string
    option env="PKGS_ROOT"
    default "packages"

config LVGL_DIR
    string
    option env="LVGL_DIR"
    default "./littlevGL7.1.0"

config ENV_DIR
    string
    option env="ENV_ROOT"
    default "/"

source "$RTT_DIR/Kconfig"
source "$LVGL_DIR/Kconfig"	
source "$PKGS_DIR/Kconfig"


config SOC_TINA
    bool 
    select ARCH_ARM_ARM9
    default y

source "$BSP_DIR/drivers/Kconfig"
```
